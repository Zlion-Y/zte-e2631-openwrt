## _wire/b2/drivers/net/ethernet/zte/Kconfig
```kconfig
# SPDX-License-Identifier: GPL-2.0-only
config NET_VENDOR_ZTE
	bool "ZTE devices"
	depends on ARCH_ZTE || COMPILE_TEST
	default y
	help
	  If you have a network (Ethernet) device belonging to this class, say Y.

	  Note that the answer to this question doesn't directly affect the
	  kernel: saying N will just cause the configurator to skip all
	  the questions about ZTE devices.

if NET_VENDOR_ZTE

config ZX_NPU
	bool "ZTE ZX279128S npu scaffold"
	depends on OF
	help
	  Builds the npu scaffold. It exposes /proc/zx-npu/status and performs
	  no MMIO access; the vendor-native wired and MT7916 data paths are
	  added incrementally on the native line.

	  If unsure, say Y on this board.

config ZX_NPU_AUDIT
	bool "ZTE ZX279128S npu read-only register audit"
	depends on OF
	help
	  Maps the NPP/IDM/TM/PP accelerator windows and exposes a proc file
	  that reads a small documented set of registers only when userspace
	  writes "run". It never writes a register.

	  If unsure, say Y on this board.

endif # NET_VENDOR_ZTE
```

## _wire/b4/drivers/net/ethernet/zte/Kconfig
```kconfig
# SPDX-License-Identifier: GPL-2.0-only
config NET_VENDOR_ZTE
	bool "ZTE devices"
	depends on ARCH_ZTE || COMPILE_TEST
	default y
	help
	  If you have a network (Ethernet) device belonging to this class, say Y.

	  Note that the answer to this question doesn't directly affect the
	  kernel: saying N will just cause the configurator to skip all
	  the questions about ZTE devices.

if NET_VENDOR_ZTE

config ZX_NPU
	bool "ZTE ZX279128S npu scaffold"
	depends on OF
	help
	  Builds the npu scaffold. It exposes /proc/zx-npu/status and performs
	  no MMIO access; the vendor-native wired and MT7916 data paths are
	  added incrementally on the native line.

	  If unsure, say Y on this board.

config ZX_NPU_AUDIT
	bool "ZTE ZX279128S npu read-only register audit"
	depends on OF
	help
	  Maps the NPP/IDM/TM/PP accelerator windows and exposes a proc file
	  that reads a small documented set of registers only when userspace
	  writes "run". It never writes a register.

	  If unsure, say Y on this board.

config ZX_NPU_IDM
	bool "ZTE ZX279128S vendor-native IDM fabric engine"
	depends on OF
	help
	  Builds the zxnpu0 netdev and the IDM RX/TX ring engine. The
	  hardware is untouched until zxnpu_idm.enable=1 and the netdev is
	  opened; the default firmware therefore keeps every write out.

	  If unsure, say Y on this board.

config ZX_NPU_PPE
	bool "ZTE ZX279128S vendor-native PPE/CLA access"
	depends on OF
	help
	  Low-level CLA/SBRG indirect table access for the vendor-native
	  wired data plane. The proc interface is inert until
	  zxnpu_ppe.enable=1.

	  If unsure, say Y on this board.

endif # NET_VENDOR_ZTE
```
